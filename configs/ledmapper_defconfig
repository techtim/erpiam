## configs/ledmapper_defconfig
```kconfig
BR2_arm=y
BR2_cortex_a53=y
BR2_ARM_FPU_NEON_FP_ARMV8=y
BR2_OPTIMIZE_3=y

BR2_TOOLCHAIN_BUILDROOT_VENDOR="uwyn"
BR2_TOOLCHAIN_BUILDROOT_GLIBC=y
BR2_TOOLCHAIN_BUILDROOT_CXX=y

BR2_PACKAGE_HOST_LINUX_HEADERS_CUSTOM_4_9=y
BR2_BINUTILS_VERSION_2_30_X=y
BR2_GCC_VERSION_7_X=y

BR2_SYSTEM_BIN_SH_BASH=y
BR2_SYSTEM_DHCP="eth0"

BR2_TARGET_GENERIC_HOSTNAME="LedMapper"
BR2_TARGET_GENERIC_ISSUE="Welcome to LedMapper"

BR2_ROOTFS_DEVICE_CREATION_DYNAMIC_MDEV=y
# BR2_TARGET_GENERIC_GETTY is not set
# BR2_TARGET_GENERIC_REMOUNT_ROOTFS_RW is not set
BR2_ROOTFS_OVERLAY="$(TOPDIR)/board/ledmapper/overlay/"
BR2_ROOTFS_POST_BUILD_SCRIPT="board/ledmapper/post-build.sh"
BR2_ROOTFS_POST_IMAGE_SCRIPT="board/ledmapper/post-image.sh"

# Kernel
BR2_LINUX_KERNEL=y
BR2_LINUX_KERNEL_CUSTOM_GIT=y
BR2_LINUX_KERNEL_CUSTOM_REPO_URL="https://github.com/raspberrypi/linux.git"
BR2_LINUX_KERNEL_CUSTOM_REPO_VERSION="33ee56d5927ceff630fbc87e3f5caa409b6ae114"
BR2_LINUX_KERNEL_PATCH="output/build/ledmapper_kernel.patch"
BR2_LINUX_KERNEL_USE_CUSTOM_CONFIG=y
BR2_LINUX_KERNEL_CUSTOM_CONFIG_FILE="board/ledmapper/linux.config"
BR2_LINUX_KERNEL_DTS_SUPPORT=y
BR2_LINUX_KERNEL_INTREE_DTS_NAME="bcm2710-rpi-3-b bcm2710-rpi-cm3"

# Packages to install
BR2_PACKAGE_LEDMAPPER=y
BR2_PACKAGE_LEDMAPPER_CONFIG_DTOVERLAY="pi3-miniuart-bt"
BR2_PACKAGE_LEDMAPPER_CONFIG_DTPARAM="audio=on"

# BR2_PACKAGE_LEDMAPPER_MAIN=y left for later app
BR2_PACKAGE_BUSYBOX_SHOW_OTHERS=y
# BR2_PACKAGE_ALSA_UTILS=y
# BR2_PACKAGE_ALSA_UTILS_ALSACONF=y
# BR2_PACKAGE_ALSA_UTILS_AMIDI=y
# BR2_PACKAGE_ALSA_UTILS_APLAY=y
# BR2_PACKAGE_ALSA_UTILS_APLAYMIDI=y
# BR2_PACKAGE_ALSA_UTILS_ARECORDMIDI=y
# BR2_PACKAGE_ALSA_UTILS_SPEAKER_TEST=y
BR2_PACKAGE_DEJAVU=y
BR2_PACKAGE_XORG7=y
BR2_PACKAGE_XSERVER_XORG_SERVER=y
BR2_PACKAGE_XSERVER_XORG_SERVER_KDRIVE=y
BR2_PACKAGE_XSERVER_XORG_SERVER_KDRIVE_EVDEV=y
BR2_PACKAGE_XSERVER_XORG_SERVER_KDRIVE_KBD=y
BR2_PACKAGE_XSERVER_XORG_SERVER_KDRIVE_MOUSE=y
BR2_PACKAGE_XDATA_XCURSOR_THEMES=y
BR2_PACKAGE_XTERM=y
BR2_PACKAGE_LIBSHA1=y
BR2_PACKAGE_OPENSSL=y
BR2_PACKAGE_LIBPCIACCESS=y
BR2_PACKAGE_TAR=y
BR2_PACKAGE_NANO=y
BR2_PACKAGE_WIRINGPI=y

# Filesystem / image
BR2_TARGET_ROOTFS_EXT2=y
BR2_TARGET_ROOTFS_EXT2_4=y
BR2_TARGET_ROOTFS_EXT2_SIZE="200M"

# Required tools to create the SD image
# BR2_TARGET_ROOTFS_TAR is not set
BR2_PACKAGE_HOST_DOSFSTOOLS=y
BR2_PACKAGE_HOST_GENIMAGE=y
BR2_PACKAGE_HOST_MTOOLS=y
```

## package/ledmapper-listen/Config.in
```kconfig
config BR2_PACKAGE_LEDMAPPER_LISTEN
        bool "LedMapper Listener"
        select BR2_PACKAGE_WIRINGPI
        depends on BR2_INSTALL_LIBSTDCPP
        depends on BR2_TOOLCHAIN_HAS_THREADS
        depends on BR2_TOOLCHAIN_USES_GLIBC
        help
          LedMapper cpp UDP listener and frame streamer 
```

## package/ledmapper/Config.in
```kconfig
config BR2_PACKAGE_LEDMAPPER
	bool "LedMapper"
	select BR2_PACKAGE_RPI_FIRMWARE
	help
	  Embedded Raspberry PI 3 Linux distribution for light control

if BR2_PACKAGE_LEDMAPPER

config BR2_PACKAGE_LEDMAPPER_X11_NOCURSOR
	bool "Hide X11 cursor"
	help
	  Hide the mouse cursor in X11

config BR2_PACKAGE_LEDMAPPER_CONFIG_DTOVERLAY
	string "Device tree overlays"
	help
	  Device tree overlays that will be added to config.xml

config BR2_PACKAGE_LEDMAPPER_CONFIG_DTPARAM
	string "Device tree params"
	help
	  Device tree parameters that will be added to config.xml

config BR2_PACKAGE_LEDMAPPER_BOOT_SPLASH
	string "Path to ASCII PPM splash image"
	default "package/ledmapper/logo_linux_clut224.ppm"
	help
	  The path towards an ASCII PPM image that will be compiled into the
	  Linux kernel to use as a boot splash screen

endif # BR2_PACKAGE_LEDMAPPER
```
